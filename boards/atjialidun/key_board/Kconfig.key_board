## build_release/KEYBOARD/Kconfig/Kconfig.shield.defconfig
```kconfig
osource "C:/NRF/KEYBOARD/boards/shields/*/Kconfig.defconfig"
osource "C:/ncs/v3.2.3/nrf/boards/shields/*/Kconfig.defconfig"
```

## build_release/KEYBOARD/Kconfig/boards/Kconfig.defconfig
```kconfig
# Load Zephyr board defconfig descriptions.
osource "C:/NRF/KEYBOARD/boards/atjialidun/key_board/Kconfig.defconfig"
```

## build_release/KEYBOARD/Kconfig/boards/Kconfig.key_board
```kconfig
# Load board Kconfig descriptions.
osource "C:/NRF/KEYBOARD/boards/atjialidun/key_board/Kconfig.key_board"
```

## build_release/Kconfig/Kconfig.shield
```kconfig
osource "C:/NRF/KEYBOARD/boards/shields/*/Kconfig.shield"
osource "C:/ncs/v3.2.3/nrf/boards/shields/*/Kconfig.shield"
```

## build_release/Kconfig/boards/Kconfig
```kconfig
# Load Zephyr board Kconfig descriptions.
osource "C:/NRF/KEYBOARD/boards/atjialidun/key_board/Kconfig"
```
